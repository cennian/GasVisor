## CMakeLists.txt
```
#
# Copyright (c) 2020 Nordic Semiconductor
#
# SPDX-License-Identifier: LicenseRef-Nordic-5-Clause
#

cmake_minimum_required(VERSION 3.20.0)

find_package(Zephyr REQUIRED HINTS $ENV{ZEPHYR_BASE})
project(Gasvisorfirmware)

# NORDIC SDK APP START
target_sources(app PRIVATE src/main.c)
target_sources(app PRIVATE src/BatteryStatus.c)
target_sources(app PRIVATE src/SleepMode.c)
target_sources(app PRIVATE src/Weight_Sensor.c)
target_sources(app PRIVATE src/IoTConnectSDK.c)

# NORDIC SDK APP END
```

## prj.conf
```kconfig
CONFIG_NRF_MODEM_LIB=y
CONFIG_DATE_TIME=y

CONFIG_NETWORKING=y
CONFIG_NET_SOCKETS=y
CONFIG_NET_SOCKETS_POSIX_NAMES=y
CONFIG_NET_NATIVE=n

CONFIG_HEAP_MEM_POOL_SIZE=8192
CONFIG_MAIN_STACK_SIZE=8192

CONFIG_MODEM_KEY_MGMT=y
CONFIG_LTE_LINK_CONTROL=y

CONFIG_LTE_AUTO_INIT_AND_CONNECT=n
CONFIG_LTE_NETWORK_MODE_LTE_M=y

# PDN library
CONFIG_PDN=y
CONFIG_PDN_ESM_STRERROR=y

# AT Host
CONFIG_NEWLIB_LIBC=y
CONFIG_AT_HOST_LIBRARY=y

# MQTT
CONFIG_MQTT_LIB=y
CONFIG_MQTT_LIB_TLS=y

# CJSON
CONFIG_NEWLIB_LIBC_FLOAT_PRINTF=y
CONFIG_CJSON_LIB=y

# POWER MANAGEMENT
CONFIG_PM_DEVICE=y

#Sensor configurations
CONFIG_SENSOR=y
CONFIG_HX711=y

# ADC Configuration
CONFIG_ADC=y

# Debugging configurations
CONFIG_DEBUG_OPTIMIZATIONS=y
CONFIG_DEBUG_THREAD_INFO=y

# FLOAT DATA TYPE
CONFIG_CBPRINTF_FP_SUPPORT=y

#lOGGING
CONFIG_LOG=y

CONFIG_FLASH=y
CONFIG_FLASH_PAGE_LAYOUT=y
CONFIG_FLASH_MAP=y
CONFIG_NVS=y
CONFIG_SETTINGS=y
CONFIG_SETTINGS_NVS_SECTOR_COUNT=8
```

## src/main.c
```c
/*
 *  DevoMech code Version 1.2
 *  Integrated with nrf sdk, this sdk does not reliably posts data on the server, it skips data psoting from 10 to 20 %.
 */

#include <string.h>
#include <zephyr/kernel.h>
#include <stdlib.h>
#include <stdint.h>
#include <zephyr/sys/printk.h>
#include <zephyr/sys/util.h>
#include <zephyr/net/socket.h>
#include <modem/nrf_modem_lib.h>
#include <zephyr/net/tls_credentials.h>
#include <modem/pdn.h>
#include <modem/lte_lc.h>
#include <modem/modem_key_mgmt.h>
#include <zephyr/pm/pm.h>
#include <zephyr/pm/device.h>
#include <zephyr/pm/state.h>
#include <zephyr/device.h>
#include <zephyr/logging/log.h>  

#include <zephyr/drivers/adc.h>
#include <zephyr/drivers/gpio.h>
#include <zephyr/settings/settings.h>

// Custom Header Files
#include "BatteryStatus.h"
#include "SleepMode.h"
#include "Weight_Sensor.h"
#include "IoTConnectSDK.h"


LOG_MODULE_REGISTER(MAIN);  
float voltage = 0;               // Voltage of Battery
uint8_t battery_percentage =0;   //Battery Percentage
char battery_data_str[14];       // Character array to store Battery Data.

#define ADC_NODE DT_NODELABEL(adcswitch) // Q1 Transistor pin to turn on ADC
#define ERROR_LED_NODE DT_NODELABEL(errordetectionled) // Error Detection LED (not being used currently in the code)

#define DEFAULT_CALIBRATION_DONE_VALUE 0

static uint8_t calibration_done = DEFAULT_CALIBRATION_DONE_VALUE;

extern const struct device *hx711_dev; /* This device will be used for measurement of load cell*/


/**
 * 	@brief    Sets the calibration settings.
 * 
 * 	@param[1] name The name of the calibration setting to be set. In this context, it checks for "done".
 * 	@param[2] len The length of the data to be read for the calibration setting.
 * 	@param[3] read_cb A callback function to read the calibration data. This function should conform to the `settings_read_cb` type.
 * 	@param[4] cb_arg A pointer to the argument that should be passed to the read_cb callback function.
 * 
 * 
 * 	@return   Returns 0 on successful setting of calibration data.
*/

static int calibration_settings_set(const char *name, size_t len,
                            settings_read_cb read_cb, void *cb_arg)
{
    const char *next;
    int rc;

    if (settings_name_steq(name, "done", &next) && !next) {
        if (len != sizeof(calibration_done)) {
            return -EINVAL;
        }

        rc = read_cb(cb_arg, &calibration_done, sizeof(calibration_done));
        if (rc >= 0) {
            return 0;
        }

        return rc;
    }

    return -ENOENT;
}


struct settings_handler my_conf = {
    .name = "calibration",
    .h_set = calibration_settings_set
};




// ***************************************** Main loop Starts here  ************************************************
/**
 * @brief   - This is the main function where the program execution begins
 * @return  - Returns 0 if the program executes successfully, otherwise returns error code.
 * @param   - None
*/
int main(void)
{
	int err;
	int fd;
	

		/* Calibration Settings Start*/
		settings_subsys_init();
		settings_register(&my_conf);
		settings_load();
		/* Calibration Settings End*/

		static const struct gpio_dt_spec BATTERY_STATE_SWITCH = GPIO_DT_SPEC_GET(ADC_NODE,gpios); // Transistor pin to switch ADC
		gpio_pin_configure_dt(&BATTERY_STATE_SWITCH,GPIO_OUTPUT); // pin used as an OUTPUT

		hx711_init();  // Initialize HX711 for measuring weight
		adc_Init();    // initialize ADC for measuring Battery Voltage

	// ******************************Initialization Done**********************************
	
		
	
			while(1){

				sleepmode();  // You can change the SleepTime in this function
				
					// Wakeup mode //
					LOG_INF("IoT COnnect sample starting\n\r");

					// Callibration will only be done one time. (For Production process)
					if (!calibration_done) {
						calibrate_sensor();
						calibration_done = 1;
						settings_save_one("calibration/done", &calibration_done, sizeof(calibration_done));
					}

					avia_hx711_power(hx711_dev,HX711_POWER_ON);  // Turn on Hx711

				
					for(int i = 0; i<3; i++) {
						k_msleep(450); 
						measure_weight();
						}

					avia_hx711_power(hx711_dev,HX711_POWER_OFF);  // Turn off Hx711

				
					voltage = 0;
					battery_percentage = 0;
				
					gpio_pin_set_dt(&BATTERY_STATE_SWITCH,1);  // Turned on Transistor (Q1)
					k_msleep(450);
					for(int i=0; i<3; i++){

						voltage += Battery_Voltage();  
						k_msleep(450);
					}
					gpio_pin_set_dt(&BATTERY_STATE_SWITCH,0); // Turned off Transistor (Q1)
					voltage = voltage/3; 				//Averaging the readings
					
					battery_percentage = CalculateBatteryPercentage(voltage);  // Calculates Battery Percentage
					printf("average_voltage: %.2f\n\r",voltage); 			   // float doesnt work on LOGS, so printf is used.
					LOG_INF("Battery: %d %%", (int)battery_percentage);
					
					snprintf(battery_data_str, sizeof(battery_data_str), "%.2f V, %d%%", voltage, battery_percentage);
    				LOG_INF("Battery Data: %s", battery_data_str);
				

					//publish data
					
					IoT_Connect_main();  // Connects to IoT connect and publishes data. (This function is under working by Avnet Team)
					lte_lc_power_off();  // Turns off LTE Modem
				
				}	
}
//****************************************************** main loop ends here ***************************************************************
```

## src/BatteryStatus.c
```c
#include "BatteryStatus.h"

#include <inttypes.h>
#include <stddef.h>


#include <zephyr/device.h>
#include <zephyr/logging/log.h>
#include <zephyr/devicetree.h>
#include <zephyr/drivers/adc.h>
#include <zephyr/kernel.h>
#include <zephyr/sys/printk.h>
#include <zephyr/sys/util.h>
 LOG_MODULE_REGISTER(BATTERY);


// // Global variables
int err;
uint16_t buf;
int32_t val_mv;
float voltage_mapped;





#if !DT_NODE_EXISTS(DT_PATH(zephyr_user)) || \
    !DT_NODE_HAS_PROP(DT_PATH(zephyr_user), io_channels)
#error "No suitable devicetree overlay specified"
#endif

#define DT_SPEC_AND_COMMA(node_id, prop, idx) \
    ADC_DT_SPEC_GET_BY_IDX(node_id, idx),

/* Data of ADC io-channels specified in devicetree. */
static const struct adc_dt_spec adc_channels[] = {
    DT_FOREACH_PROP_ELEM(DT_PATH(zephyr_user), io_channels,
                         DT_SPEC_AND_COMMA)
};

struct adc_sequence sequence = {
    .buffer = &buf,
    /* buffer size in bytes, not number of samples */
    .buffer_size = sizeof(buf),
};

/*********************************************************************
 * @fn                - Battery_Voltage
 *
 * @brief             - Reads the battery voltage via ADC, converts it to millivolts, 
 *                      and then maps it to the corresponding voltage value (according to Voltage Divider).
 *
 * @return            - The mapped voltage value as a float.
 *
 * @Note              - This function is used for Voltage Divider ( R1 = 100, R2 = 100).
 */
float Battery_Voltage(void) {
    (void)adc_sequence_init_dt(&adc_channels[0], &sequence);
    err = adc_read(adc_channels[0].dev, &sequence);
    if (err < 0) {
        LOG_WRN("Could not read (%d)", err);
        return;
    }

    val_mv = (int16_t)buf;
    LOG_INF("Analog Value: %" PRId32, val_mv);
    err = adc_raw_to_millivolts_dt(&adc_channels[0], &val_mv);
    if (err < 0) {
        LOG_INF(" (value in mV not available)");
    } else {
        //LOG_INF(" Milli_Voltage: = %" PRId32 " mV", val_mv);
    }

    float voltage = (float)val_mv / 1000.0; // Convert millivolts to volts
    voltage_mapped = 2 * voltage;
   

    return voltage_mapped;

    
}

/*********************************************************************
 * @fn                - adc_Init
 *
 * @brief             - Initializes the ADC for battery voltage reading.
 *
 * @return            - void
 *
 * @Note              - This function checks if the ADC device is ready and sets up 
 *                      the ADC channel for reading the battery voltage.
 */
void adc_Init(void) {
    if (!adc_is_ready_dt(&adc_channels[0])) {
        LOG_ERR("ADC controller device %s not ready", adc_channels[0].dev->name);
        return;
    }

    err = adc_channel_setup_dt(&adc_channels[0]);
    if (err < 0) {
        LOG_ERR("Could not setup channel #%d (%d)", 0, err);
        return;
    }
}

/*********************************************************************
 * @fn                - CalculateBatteryPercentage
 *
 * @brief             - Calculates the battery percentage based on the averaged voltage.
 *
 * @param[in]         - averagedVoltage: Average of Voltage from Battery_Voltage function.
 *
 * @return            - The calculated battery percentage as an integer.
 *
 * @Note              - This function computes the battery percentage by mapping the 
 *                      averaged voltage between a defined minimum and maximum voltage.
 */
int CalculateBatteryPercentage(float averagedVoltage) {
    int battery_percentage = (averagedVoltage - MIN_BATTERY_VOLTAGE) / (MAX_BATTERY_VOLTAGE - MIN_BATTERY_VOLTAGE) * 100;

    // Clamp the percentage to the range [0, 100]
    if (battery_percentage > 100) {
        battery_percentage = 100;
    } else if (battery_percentage < 0) {
        battery_percentage = 0;
    }

    return battery_percentage;
}
```

## src/BatteryStatus.h
```c
#ifndef BATTERYSTATUS_H
#define BATTERYSTATUS_H

    #include <stdint.h>

    #define MAX_BATTERY_VOLTAGE 2.07
    #define MIN_BATTERY_VOLTAGE 1.48


    float Battery_Voltage(void);
    void adc_Init(void);
    int CalculateBatteryPercentage(float);


#endif
```

## src/IoTConnectSDK.h
```c
#ifndef IOTCONNECTSDK_H
#define IOTCONNECTSDK_H


#include <zephyr/kernel.h>
#include <cJSON.h>
#include <time.h>

#define HTTPS_PORT "443"
#define HTTPS_HOSTNAME "discovery.iotconnect.io"

#define CONFIG_MQTT_LIB_TLS

// Declare the sleepTime variable
extern unsigned long sleepTime;

#if defined CONFIG_MQTT_LIB_TLS
#define IOTCONNECT_SERVER_MQTT_PORT         8883
#else
#define IOTCONNECT_SERVER_MQTT_PORT         1883
#endif

#define IOTCONNECT_SERVER_HTTP_PORT         443
#define MAXLINE 4096
#define TLS_SEC_TAG 42

int MQTT_Init(void);
int tls_setup(int fd);
void GetAllTwins(void);
int subscribe(void);
int broker_init(void);
void Received_cmd(char *in_cmd);
void UpdateTwin(char *key, char *value);
int provision_certificates(void);
int GetTimeDiff(char newT[25], char oldT[25]);
int Save_Sync_Responce(char *sync_data);
int SendData(char *Attribute_json_Data);
int fds_init(struct mqtt_client *c);
void TwinUpdateCallback(char *payload);
void DeviceCallback(char *payload);
int client_init(struct mqtt_client *client);
char *get_base_url(char*Host, char *cpid, char *env);
char *Sync_call(char *cpid, char *uniqueid, char *base_url);
void SendAck(char *Ack_Data, int messageType);
typedef void (*IOTConnectCallback)(char *PayLoad);
void data_print(uint8_t *prefix, uint8_t *data, char *topic, size_t len);
void mqtt_evt_handler(struct mqtt_client *const c, const struct mqtt_evt *evt);
int data_publish(struct mqtt_client *c, char *topic, enum mqtt_qos qos, uint8_t *data, size_t len);
int IoTConnect_init(char *CpID, char *UniqueID, IOTConnectCallback CallBack, IOTConnectCallback TwinCallBack, char *Env);
int IoTConnect_connect();
int IoTConnect_abort();

void IoT_Connect_main(void);

char *Sensor_data(void);


char *Get_Time(void);



#endif /* IOTCONNECTSDK_H */
```

## src/IoTConnect_Config.h
```c
#ifndef IOTCONNECT_CONFIG_H
#define IOTCONNECT_CONFIG_H

/* IoTConnect credential configuration */
#define IOTCONNECT_DEVICE_UNIQUE_ID    "DevoDevice4"
#define IOTCONNECT_DEVICE_CP_ID        "75931fa19a194a7aa64d2565a942051d"
#define IOTCONNECT_DEVICE_ENV          "emea"

//#define IOTCONNECT_DEVICE_UNIQUE_ID    "DevoDevice1"
//#define IOTCONNECT_DEVICE_CP_ID        "75931fa19a194a7aa64d2565a942051d"
//#define IOTCONNECT_DEVICE_ENV          "emea"

// #define IOTCONNECT_DEVICE_UNIQUE_ID    "CASignTest01"
// #define IOTCONNECT_DEVICE_CP_ID        "4D6DC30B902445FD9D753A4CDAEB4C06"
// #define IOTCONNECT_DEVICE_ENV          "emea"

/* IoTConnect server port configuration */



#endif /* IOTCONNECT_CONFIG_H */
```

## src/SleepMode.c
```c
#include "SleepMode.h"


LOG_MODULE_REGISTER(SLEEPMDOE);


unsigned long sleepTime  =  5 *  60 * 1000UL;
const struct device *const cons = DEVICE_DT_GET(DT_CHOSEN(zephyr_console));

	
   


/*********************************************************************
 * @fn      		  - sleepmode
 *
 * @brief             This function puts the device into a sleep mode.
 *
 * @param[in]         None.
 *
 * @return            None.
 *
 * @Note              This function checks if the device is ready,
 *                    suspends it, sleeps for the specified time, and then
 *                    resumes the device. Sleep Time can be changed from sleepTime.
 */
void sleepmode()
{
        if(!device_is_ready(cons))
    {
		 LOG_ERR("%s: device not ready.\n", cons->name);
		return 0;
	}
		pm_device_action_run(cons, PM_DEVICE_ACTION_SUSPEND);
		k_msleep(sleepTime);
		pm_device_action_run(cons, PM_DEVICE_ACTION_RESUME);
}
```

## src/SleepMode.h
```c
#ifndef SLEEPMODE_H
#define SLEEPMODE_H
#include <zephyr/kernel.h>
#include <zephyr/device.h>
#include <zephyr/logging/log.h>
#include <inttypes.h>
#include <stddef.h>
#include <zephyr/devicetree.h>
#include <zephyr/pm/device.h>
#include <zephyr/pm/pm.h>



void sleepmode(void);


#endif
```

## src/Weight_Sensor.c
```c
 #include "Weight_Sensor.h"

// Register the module for logging purposes
 LOG_MODULE_REGISTER(WEIGHT);

 const struct device *hx711_dev; /* This device will be used for the measurement of load cell*/

 int reference_weight_grams = 2000;  /* Calibrated for 2000 grams, needs more fine-tuning*/
 int calibration_iterations = 2;

 int16_t weight_grams;              // Variable to store the measured weight in grams


/*********************************************************************
 * @fn      		  - hx711_init
 *
 * @brief             Initializes the HX711 sensor device.
 *
 * @param[in]         None.
 *
 * @return            None.
 *
 * @Note              This function initializes the HX711 sensor device
 *                    and logs its name.
 */
 void hx711_init()
 {
      // Initialize the HX711 sensor
     hx711_dev = DEVICE_DT_GET_ANY(avia_hx711);
     __ASSERT(hx711_dev == NULL, "Failed to get device binding\n");

    LOG_INF("Device is %p, name is %s", hx711_dev, hx711_dev->name);

 }

/*********************************************************************
 * @fn      		  - calibrate_sensor
 *
 * @brief             Calibrates the HX711 load cell sensor.
 *
 * @param[in]         None.
 *
 * @return            None.
 *
 * @Note              This function performs sensor tare, wait for some time, and then
 *                    calibrates the sensor using the reference weight.
 */
 void calibrate_sensor(void) {

     avia_hx711_tare(hx711_dev, calibration_iterations);

     // Wait for the user to place the reference weight on the sensor


 	LOG_INF("Calibrating load cells----\n");
    for (int i = calibration_iterations; i >= 0; i--) {
        LOG_INF(" %d..", i);
        k_msleep(250);
    }

//     // Calibrate the sensor using the reference weight
     avia_hx711_calibrate(hx711_dev, reference_weight_grams, calibration_iterations);

     LOG_INF("Calibration complete.\n");
 }


/*********************************************************************
 * @fn      		  - measure_weight
 *
 * @brief             - Measures the weight using the HX711 sensor.
 *
 * @param[in]         - None.
 *
 * @return            - None.
 *
 * @Note              - This function fetches and measures the weight using
 *                      the HX711 sensor and logs the measured weight in grams.
 */
void measure_weight(void) {
    static struct sensor_value weight;
    int ret;

    ret = sensor_sample_fetch(hx711_dev);
    if (ret != 0) {
        LOG_ERR("Cannot take measurement: %d", ret);
    } else {
        sensor_channel_get(hx711_dev, HX711_SENSOR_CHAN_WEIGHT, &weight);
        LOG_INF("Weight: %d.%06d grams", weight.val1, weight.val2);
    }
	 weight_grams = weight.val1 + weight.val2;
     if(weight_grams <0){
        weight_grams =0;
     }
     else if(weight_grams>32767){
        weight_grams = 32000;
     }

}
```

## src/Weight_Sensor.h
```c
#ifndef WEIGHT_SENSOR_H
#define WEIGHT_SENSOR_H

#include <sensor/hx711/hx711.h>
#include <zephyr/logging/log.h>

void calibrate_sensor(void);
void measure_weight(void);


#endif
```

## src/certificates.h
```c
#define CLOUD_CLIENT_PRIVATE_KEY \
"-----BEGIN RSA PRIVATE KEY-----\n"
----------------------------------
----------------------------------
"-----END RSA PRIVATE KEY-----\n"

#define CLOUD_CLIENT_PUBLIC_CERTIFICATE \
"-----BEGIN CERTIFICATE-----\n"
----------------------------------
----------------------------------
"-----END CERTIFICATE-----\n"

#define CLOUD_CA_CERTIFICATE \
"-----BEGIN CERTIFICATE-----\n" \

---- Already add in here -------
-------Do Not Change -----------

"-----END CERTIFICATE-----\n"
```
