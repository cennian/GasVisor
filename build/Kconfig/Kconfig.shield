## build/Kconfig/Kconfig.shield
```kconfig
osource "c:/battery_status_code_nrf91/boards/shields/*/Kconfig.shield"
osource "c:/users/ammar/desktop/gasvisorfirmware/boards/shields/*/Kconfig.shield"
osource "C:/ncs/v2.5.0/nrf/boards/shields/*/Kconfig.shield"
```

## build/Kconfig/Kconfig.shield.defconfig
```kconfig
osource "c:/battery_status_code_nrf91/boards/shields/*/Kconfig.defconfig"
osource "c:/users/ammar/desktop/gasvisorfirmware/boards/shields/*/Kconfig.defconfig"
osource "C:/ncs/v2.5.0/nrf/boards/shields/*/Kconfig.defconfig"
```
